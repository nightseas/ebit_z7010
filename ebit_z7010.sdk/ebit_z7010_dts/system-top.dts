/*
 * CAUTION: This file is automatically generated by Xilinx.
 * Version: XSCT 2018.3.1
 * Today is: Tue Mar 17 23:05:40 2020
 */


/dts-v1/;
#include "zynq-7000.dtsi"
#include "pl.dtsi"
#include "pcw.dtsi"
/ {
	chosen {
		bootargs = "earlycon";
		stdout-path = "serial0:115200n8";
	};
	aliases {
		ethernet0 = &gem0;
		serial0 = &uart1;
		serial1 = &com_x16_com_0;
		serial10 = &com_x16_com_3;
		serial11 = &com_x16_com_4;
		serial12 = &com_x16_com_5;
		serial13 = &com_x16_com_6;
		serial14 = &com_x16_com_7;
		serial15 = &com_x16_com_8;
		serial16 = &com_x16_com_9;
		serial2 = &com_x16_com_1;
		serial3 = &com_x16_com_10;
		serial4 = &com_x16_com_11;
		serial5 = &com_x16_com_12;
		serial6 = &com_x16_com_13;
		serial7 = &com_x16_com_14;
		serial8 = &com_x16_com_15;
		serial9 = &com_x16_com_2;
	};
	memory {
		device_type = "memory";
		reg = <0x0 0x10000000>;
	};
};
